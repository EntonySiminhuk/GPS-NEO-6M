#include <stdio.h>
#include <stdarg.h>
#include <string.h>
#include "oled.h"
#include "driver/i2c_master.h"
#include "driver/gpio.h"
#include "freertos/FreeRTOS.h"
#include "freertos/task.h"

#define OLED_SDA    GPIO_NUM_17
#define OLED_SCL    GPIO_NUM_18
#define OLED_RST    GPIO_NUM_21
#define OLED_ADDR   0x3C
#define OLED_W      128
#define OLED_H      64

static i2c_master_dev_handle_t oled_dev;
static uint8_t fb[1 + OLED_W * OLED_H / 8];   // fb[0] = 0x40 (prefixo de dados)
static uint8_t *const buf = &fb[1];

// Fonte 5x7, ASCII 0x20..0x7E (bit 0 = pixel de cima)
static const uint8_t font5x7[][5] = {
    {0x00,0x00,0x00,0x00,0x00}, {0x00,0x00,0x5F,0x00,0x00}, {0x00,0x07,0x00,0x07,0x00}, {0x14,0x7F,0x14,0x7F,0x14}, // ' ' ! " #
    {0x24,0x2A,0x7F,0x2A,0x12}, {0x23,0x13,0x08,0x64,0x62}, {0x36,0x49,0x55,0x22,0x50}, {0x00,0x05,0x03,0x00,0x00}, // $ % & '
    {0x00,0x1C,0x22,0x41,0x00}, {0x00,0x41,0x22,0x1C,0x00}, {0x08,0x2A,0x1C,0x2A,0x08}, {0x08,0x08,0x3E,0x08,0x08}, // ( ) * +
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    {0x00,0x00,0x7F,0x00,0x00}, {0x00,0x41,0x36,0x08,0x00}, {0x08,0x04,0x08,0x10,0x08},                             // | } ~
};

static esp_err_t oled_cmds(const uint8_t *cmds, size_t n)
{
    uint8_t tmp[32];
    tmp[0] = 0x00;  // prefixo de comando
    memcpy(&tmp[1], cmds, n);
    return i2c_master_transmit(oled_dev, tmp, n + 1, 100);
}

esp_err_t oled_init(void)
{
    // Reset do display
    gpio_reset_pin(OLED_RST);
    gpio_set_direction(OLED_RST, GPIO_MODE_OUTPUT);
    gpio_set_level(OLED_RST, 0);
    vTaskDelay(pdMS_TO_TICKS(20));
    gpio_set_level(OLED_RST, 1);
    vTaskDelay(pdMS_TO_TICKS(20));

    i2c_master_bus_config_t bus_cfg = {
        .i2c_port = I2C_NUM_0,
        .sda_io_num = OLED_SDA,
        .scl_io_num = OLED_SCL,
        .clk_source = I2C_CLK_SRC_DEFAULT,
        .glitch_ignore_cnt = 7,
        .flags.enable_internal_pullup = true,
    };
    i2c_master_bus_handle_t bus;
    esp_err_t err = i2c_new_master_bus(&bus_cfg, &bus);
    if (err != ESP_OK) {
        return err;
    }

    i2c_device_config_t dev_cfg = {
        .dev_addr_length = I2C_ADDR_BIT_LEN_7,
        .device_address = OLED_ADDR,
        .scl_speed_hz = 400000,
    };
    err = i2c_master_bus_add_device(bus, &dev_cfg, &oled_dev);
    if (err != ESP_OK) {
        return err;
    }

    static const uint8_t init[] = {
        0xAE,        // display off
        0xD5, 0x80,  // clock
        0xA8, 0x3F,  // multiplex 64
        0xD3, 0x00,  // offset 0
        0x40,        // start line 0
        0x8D, 0x14,  // charge pump on
        0x20, 0x00,  // modo de enderecamento horizontal
        0xA1,        // espelha colunas
        0xC8,        // espelha linhas
        0xDA, 0x12,  // pinos COM
        0x81, 0xCF,  // contraste
        0xD9, 0xF1,  // pre-charge
        0xDB, 0x40,  // VCOMH
        0xA4,        // mostra o conteudo da RAM
        0xA6,        // normal (nao invertido)
        0xAF,        // display on
    };
    err = oled_cmds(init, sizeof(init));
    if (err != ESP_OK) {
        return err;
    }

    oled_clear();
    return oled_update();
}

void oled_clear(void)
{
    memset(buf, 0, OLED_W * OLED_H / 8);
}

void oled_text(int col, int row, const char *str)
{
    if (row < 0 || row > 7) {
        return;
    }
    int x = col * 6;
    for (; *str && x <= OLED_W - 6; str++, x += 6) {
        char c = *str;
        if (c < 0x20 || c > 0x7E) {
            c = '?';
        }
        memcpy(&buf[row * OLED_W + x], font5x7[c - 0x20], 5);
        buf[row * OLED_W + x + 5] = 0x00;  // espaco entre caracteres
    }
}

void oled_printf(int col, int row, const char *fmt, ...)
{
    char s[22];
    va_list args;
    va_start(args, fmt);
    vsnprintf(s, sizeof(s), fmt, args);
    va_end(args);
    oled_text(col, row, s);
}

void oled_hline(int row)
{
    if (row < 0 || row > 7) {
        return;
    }
    for (int x = 0; x < OLED_W; x++) {
        buf[row * OLED_W + x] |= 0x08;
    }
}

esp_err_t oled_update(void)
{
    static const uint8_t area[] = {
        0x21, 0, OLED_W - 1,   // colunas 0..127
        0x22, 0, OLED_H / 8 - 1, // paginas 0..7
    };
    esp_err_t err = oled_cmds(area, sizeof(area));
    if (err != ESP_OK) {
        return err;
    }
    fb[0] = 0x40;  // prefixo de dados
    return i2c_master_transmit(oled_dev, fb, sizeof(fb), 100);
}
